## block_device/Kconfig
```kconfig
config BIO_BASED_MODE
    bool "Bio based"
    help
        If this field is set,the bio based mode will be used.
        Otherwise request based mode will be used.

config BLOCK_DEVICE_INFO
    bool "Show info"
    help
        Show all info data, when functions is called.
```

## network_device/Kconfig
```kconfig
config SNULL_TIMEOUT
    int "SNULL timeout"
    default 5
    help
        Set timeout value in jig

config SNULL_NAPI
    bool "SNULL napi"
    default y
    help
        Activate napi in SNULL device

config SNULL_LOCKUP
    int "SNULL lockup"
    default 0
    help
        Transmitter lockup simulation

config POOL_SIZE
    int "SNULL pool size"
    default 8
    help
        Pool size for SNULL device
```
